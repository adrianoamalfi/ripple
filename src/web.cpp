#include "web.h"

#include <ArduinoJson.h>
#include <ESP8266WiFi.h>
#include <ESPAsyncTCP.h>
#include <ESPAsyncWebServer.h>
#include <stdio.h>

#include "dashboard_gz.h"  // generated by tools/embed_dashboard.py
#include "mqtt.h"
#include "page.h"
#include "ripple_wifi.h"
#include "wifi_setup.h"

namespace web {

namespace {

AsyncWebServer server(80);
AsyncWebSocket ws("/ws");

constexpr uint8_t kQueueSize = 4;
Command queue[kQueueSize];
volatile uint8_t qHead = 0, qTail = 0;

char json[900];  // last state, served by /api/state and pushed over the socket

// Body of the POST /api/mqtt request being received.
char mqttBody[384];
size_t mqttBodyLen = 0;
bool mqttBodyTooLarge = false;
uint32_t lastPublishMs = 0;
constexpr uint32_t kPublishIntervalMs = 200;

bool push(const Command& c) {
  const uint8_t next = (qHead + 1) % kQueueSize;
  if (next == qTail) return false;  // full: drop, the UI will resend on retry
  queue[qHead] = c;
  qHead = next;
  return true;
}

void handleText(const char* text, size_t len) {
  JsonDocument doc;
  if (deserializeJson(doc, text, len)) return;
  const char* cmd = doc["cmd"] | "";

  Command c;
  if (!strcmp(cmd, "wizard_start")) c.cmd = Cmd::WizardStart;
  else if (!strcmp(cmd, "wizard_ready")) c.cmd = Cmd::WizardReady;
  else if (!strcmp(cmd, "wizard_cancel")) c.cmd = Cmd::WizardCancel;
  else if (!strcmp(cmd, "quick_calibrate")) c.cmd = Cmd::QuickCalibrate;
  else if (!strcmp(cmd, "reset_calibration")) c.cmd = Cmd::ResetCalibration;
  else if (!strcmp(cmd, "set_threshold")) {
    c.cmd = Cmd::SetThreshold;
    c.value = doc["value"] | 0.0f;
    if (!(c.value > 0 && c.value < 1000)) return;  // also rejects NaN
  } else {
    return;
  }
  push(c);
}

void onWsEvent(AsyncWebSocket*, AsyncWebSocketClient* client, AwsEventType type, void* arg,
               uint8_t* data, size_t len) {
  if (type == WS_EVT_CONNECT) {
    if (json[0]) client->text(json);  // show something immediately
  } else if (type == WS_EVT_DATA) {
    const AwsFrameInfo* info = static_cast<const AwsFrameInfo*>(arg);
    // Only accept small, complete, single-frame text messages.
    if (info->final && info->index == 0 && info->len == len && info->opcode == WS_TEXT &&
        len < 128) {
      handleText(reinterpret_cast<const char*>(data), len);
    }
  }
}

const char* phaseName(ripple::Phase p) {
  switch (p) {
    case ripple::Phase::Uncalibrated: return "uncalibrated";
    case ripple::Phase::Calibrating: return "calibrating";
    default: return "running";
  }
}

// Hand-rolled JSON: no heap churn at 5 Hz on a chip with ~40 KB of RAM.
void buildJson(const Snapshot& s) {
  const ripple::Output& o = *s.out;
  int n = snprintf(
      json, sizeof(json),
      "{\"v\":1,\"fw\":\"%s\",\"ms\":%lu,\"rssi\":%d,\"ok\":%d,"
      "\"var\":%.2f,\"peak\":%.2f,\"thr\":%.2f,\"mean\":%.2f,\"sigma\":%.2f,\"max\":%.2f,"
      "\"score\":%.2f,\"phase\":\"%s\",\"cal\":%.2f,\"motion\":%d,\"presence\":%d,"
      "\"source\":\"%s\",\"saved\":%d,\"heap\":%lu,\"mqtt\":\"%s\","
      "\"wiz\":{\"state\":\"%s\",\"stage\":%u,\"name\":\"%s\",\"left\":%lu,\"total\":%lu}",
      RIPPLE_VERSION, static_cast<unsigned long>(s.ms), s.rssi, s.linkOk, o.variance, s.varPeak,
      o.threshold, o.baselineMean, o.baselineSigma, o.baselineMax, o.score, phaseName(o.phase),
      o.calibrationProgress, o.motion, o.presence, s.calSource, s.saved,
      static_cast<unsigned long>(s.freeHeap), s.mqttState, ripple::Calibrator::stateName(s.wizState), static_cast<unsigned>(s.wizStage) + 1,
      ripple::Calibrator::stageName(s.wizStage), static_cast<unsigned long>(s.wizSecondsLeft),
      static_cast<unsigned long>(s.wizTotalSeconds));

  if (n > 0 && s.result && s.result->valid) {
    const ripple::Calibrator::Result& r = *s.result;
    n += snprintf(json + n, sizeof(json) - n,
                  ",\"res\":{\"quality\":\"%s\",\"mean\":%.2f,\"sigma\":%.2f,\"ceil\":%.2f,"
                  "\"thr\":%.2f,\"mov\":%.2f,\"still\":%.2f,\"stillOk\":%d,\"hold\":%u}",
                  ripple::Calibrator::qualityName(r.quality), r.baselineMean, r.baselineSigma,
                  r.noiseCeiling, r.threshold, r.movingCoverage, r.stillCoverage,
                  r.stillDetectable, static_cast<unsigned>(r.holdoutFalseSeconds));
  }
  if (n > 0) {
    char net[72];
    ripple::wifi::escapeJson(s.net, net, sizeof(net));
    n += snprintf(json + n, sizeof(json) - n, ",\"net\":\"%s\",\"host\":\"%s\"", net, s.host);
  }
  if (n > 0 && static_cast<size_t>(n) < sizeof(json) - 2) {
    json[n] = '}';
    json[n + 1] = 0;
  } else {
    json[0] = 0;  // truncated: better to send nothing than broken JSON
  }
}

}  // namespace

void begin() {
  ws.onEvent(onWsEvent);
  server.addHandler(&ws);

  // Main dashboard: the gzipped single-file React app, streamed from flash.
  // Falls back to the small built-in page if the firmware was built without it.
  server.on("/", HTTP_GET, [](AsyncWebServerRequest* req) {
    if (wifi_setup::portalActive()) {  // the board is running its setup network
      wifi_setup::sendPortalPage(req);
      return;
    }
#if RIPPLE_HAS_DASHBOARD
    static const char kEtag[] = "\"" DASHBOARD_ETAG "\"";
    const AsyncWebHeader* inm = req->getHeader("If-None-Match");
    if (inm && inm->value() == kEtag) {
      req->send(304);  // the browser already has this version: don't resend ~230 KB
      return;
    }
    AsyncWebServerResponse* res =
        req->beginResponse(200, "text/html", DASHBOARD_GZ, DASHBOARD_GZ_LEN);
    res->addHeader("Content-Encoding", "gzip");
    res->addHeader("ETag", kEtag);
    res->addHeader("Cache-Control", "no-cache");  // always revalidate, cheap thanks to the ETag
    req->send(res);
#else
    req->send_P(200, "text/html", INDEX_HTML);
#endif
  });
  // Tiny dependency-free page, kept as a fallback (e.g. if the dashboard misbehaves).
  server.on("/lite", HTTP_GET, [](AsyncWebServerRequest* req) {
    req->send_P(200, "text/html", INDEX_HTML);  // straight from flash, not copied to RAM
  });
  server.on("/api/state", HTTP_GET, [](AsyncWebServerRequest* req) {
    if (json[0]) req->send(200, "application/json", json);
    else req->send(503, "text/plain", "starting");
  });
  // MQTT settings. The password is write-only: GET never returns it.
  server.on("/api/mqtt", HTTP_GET, [](AsyncWebServerRequest* req) {
    char buf[400];
    if (mqtt::configJson(buf, sizeof(buf))) req->send(200, "application/json", buf);
    else req->send(500, "text/plain", "error");
  });
  server.on(
      "/api/mqtt", HTTP_POST,
      [](AsyncWebServerRequest* req) {  // runs once the whole body has arrived
        char err[96] = "";
        char buf[400];
        if (mqttBodyTooLarge) {
          req->send(413, "application/json", "{\"error\":\"Request too large\"}");
        } else if (!mqtt::applyConfig(mqttBody, mqttBodyLen, err, sizeof(err))) {
          snprintf(buf, sizeof(buf), "{\"error\":\"%s\"}", err);
          req->send(400, "application/json", buf);
        } else if (mqtt::configJson(buf, sizeof(buf))) {
          req->send(200, "application/json", buf);
        } else {
          req->send(500, "text/plain", "error");
        }
        mqttBodyLen = 0;
        mqttBodyTooLarge = false;
      },
      nullptr,
      [](AsyncWebServerRequest*, uint8_t* data, size_t len, size_t index, size_t total) {
        if (index == 0) {
          mqttBodyLen = 0;
          mqttBodyTooLarge = total >= sizeof(mqttBody);
        }
        if (mqttBodyTooLarge) return;
        memcpy(mqttBody + index, data, len);
        mqttBodyLen = index + len;
      });
  wifi_setup::registerRoutes(server);
  // While the setup network is open, every other address (the connectivity checks
  // phones make, or any website) leads to the setup page: that is what pops the
  // portal up on its own.
  server.onNotFound([](AsyncWebServerRequest* req) {
    if (wifi_setup::portalActive()) req->redirect("http://192.168.4.1/");
    else req->send(404, "text/plain", "not found");
  });
  server.begin();
}

bool post(const Command& c) {
  return push(c);
}

bool poll(Command& out) {
  if (qTail == qHead) return false;
  out = queue[qTail];
  qTail = (qTail + 1) % kQueueSize;
  return true;
}

bool publish(const Snapshot& snap) {
  if (!snap.out) return false;
  if (snap.ms - lastPublishMs < kPublishIntervalMs) return false;
  lastPublishMs = snap.ms;
  buildJson(snap);
  if (json[0] && ws.count() > 0) ws.textAll(json);
  return true;
}

void loop() {
  ws.cleanupClients();
}

}  // namespace web
